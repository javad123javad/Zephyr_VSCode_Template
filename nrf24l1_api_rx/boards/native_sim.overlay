&spi0 {
    status = "okay";
	cs-gpios = <&gpio0 4 GPIO_ACTIVE_LOW>;

    nrf24l1:nrf24l1@0{
        compatible = "nordic,nrf24l01";
        reg = <0x0>;
        spi-max-frequency = <80000000>;
		addr-width = <4>;

        ce-gpios = <&gpio0 1 GPIO_ACTIVE_HIGH>;
        irq-gpios = <&gpio0 2 GPIO_ACTIVE_HIGH>;
        channel-frequency = <16>;
		rf-power-attenuation = <18>;
		lna-gain;
		tx-address = [e7 e7 e7 e7];
		rx-datapipes-number = <2>;
		rx-datapipe0-address = [e7 e7 e7 e7];
		rx-datapipe1-address = [de ad de ad];
		payload-fixed-size = <32>;
		payload-ack;
		payload-crc;
    };
		
};