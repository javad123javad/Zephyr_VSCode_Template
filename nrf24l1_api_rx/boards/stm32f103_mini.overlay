&spi1 {
        pinctrl-0 = <&spi1_sck_master_pa5 &spi1_miso_master_pa6 &spi1_mosi_master_pa7>;
        pinctrl-names = "default";
        cs-gpios = <&gpioa 4 GPIO_ACTIVE_LOW>;
        clock-frequency = <8000000>; // Max 8 Mbps for SPI
        status = "okay";

        nrf24l1: nrf24@0 {
                reg = <0>;
                addr-width = <4>;
                compatible = "nordic,nrf24l01";
                status = "okay";
                spi-max-frequency = <500000>; // This really sets frequency
                ce-gpios = <&gpioa 3 GPIO_ACTIVE_HIGH>;
                irq-gpios = <&gpioa 2 GPIO_ACTIVE_LOW>;
                channel-frequency = <16>;
                rf-power-attenuation = <18>;
                lna-gain;
                tx-address = [e7 e7 e7 e7];
                payload-fixed-size = <32>;
                rx-datapipes-number = <2>;
                rx-datapipe0-address = [e7 e7 e7 e7];
                rx-datapipe1-address = [de ad de ad];
                payload-ack;
                payload-crc;
        };
};
