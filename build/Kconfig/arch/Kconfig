## build/Kconfig/arch/Kconfig
```kconfig
# Load Zephyr Arch Kconfig descriptions.
osource "/home/javad/zephyrproject/zephyr/arch/rx/Kconfig"
osource "/home/javad/zephyrproject/zephyr/arch/x86/Kconfig"
osource "/home/javad/zephyrproject/zephyr/arch/xtensa/Kconfig"
osource "/home/javad/zephyrproject/zephyr/arch/sparc/Kconfig"
osource "/home/javad/zephyrproject/zephyr/arch/riscv/Kconfig"
osource "/home/javad/zephyrproject/zephyr/arch/posix/Kconfig"
osource "/home/javad/zephyrproject/zephyr/arch/mips/Kconfig"
osource "/home/javad/zephyrproject/zephyr/arch/arm64/Kconfig"
osource "/home/javad/zephyrproject/zephyr/arch/arm/Kconfig"
osource "/home/javad/zephyrproject/zephyr/arch/arc/Kconfig"
```

## build/Kconfig/boards/Kconfig
```kconfig
# Load Zephyr board Kconfig descriptions.
osource "/home/javad/zephyrproject/zephyr/boards/native/native_sim/Kconfig"
```

## build/Kconfig/boards/Kconfig.defconfig
```kconfig
# Load Zephyr board defconfig descriptions.
osource "/home/javad/zephyrproject/zephyr/boards/native/native_sim/Kconfig.defconfig"
```

## build/Kconfig/boards/Kconfig.native_sim
```kconfig
# Load board Kconfig descriptions.
osource "/home/javad/zephyrproject/zephyr/boards/native/native_sim/Kconfig.native_sim"
```

## build/Kconfig/boards/Kconfig.sysbuild
```kconfig
# Load Sysbuild board Kconfig descriptions.
osource "/home/javad/zephyrproject/zephyr/boards/native/native_sim/Kconfig.sysbuild"
```

## i2c_test/pca9557_driver/drivers/gpio/Kconfig.pca9557
```kconfig
# PCA9557 GPIO expander configuration options
#
# SPDX-License-Identifier: Apache-2.0

menuconfig GPIO_PCA9557
	bool "PCA9557 I2C-based GPIO expander"
	default y
	depends on DT_HAS_NXP_PCA9557_ENABLED
	depends on I2C
	help
	  Enable driver for the PCA9557 8-bit I2C GPIO expander.

	  This is a separate driver from GPIO_PCA95XX: that driver's
	  register map (paired port0/port1 registers) targets the 16-bit
	  PCA9535/39/55 family and does not work with the PCA9557, which
	  is an 8-bit, single-port part with a different, shorter map
	  (0x00 Input, 0x01 Output, 0x02 Polarity Inversion, 0x03
	  Configuration).

	  This driver ships as a ZEPHYR_EXTRA_MODULES-provided
	  out-of-tree module (see pca9557_driver/). Its module.yml must
	  declare "build.settings.dts_root: ." for DT_HAS_NXP_PCA9557_ENABLED
	  above to work at all - without it, devicetree parsing still
	  finds the binding fine, but the separate Kconfig-side
	  DT_HAS_<COMPAT>_ENABLED generator silently doesn't, and this
	  driver never gets compiled in.

if GPIO_PCA9557

config GPIO_PCA9557_INIT_PRIORITY
	int "Init priority"
	default I2C_INIT_PRIORITY
	help
	  Device driver initialization priority.

config GPIO_PCA9557_INTERRUPT
	bool "Interrupt enable"
	help
	  Enable interrupt support in the PCA9557 driver, using the
	  chip's shared INT output pin (interrupt-gpios). The PCA9557
	  has no per-pin interrupt mask register, so any configured
	  input pin contributes to the single shared interrupt line.

endif # GPIO_PCA9557
```

## mind_io/Kconfig
```kconfig
# SPDX-License-Identifier: Apache-2.0

config MIND_IO_CARD_FORMAT
	bool "mind_io card format library"
	help
	  Encoder and decoder of the I/O card description stored in the card
	  EEPROM. Selected by MIND_IO; can be enabled on its own for tools and
	  tests.

menuconfig MIND_IO
	bool "mind_io I/O card abstraction"
	default y
	depends on DT_HAS_MIND_DIN41612_IO_ENABLED
	depends on I2C
	depends on GPIO
	select MIND_IO_CARD_FORMAT
	help
	  Reads the description of the I/O card plugged into the DIN41612
	  connector at boot and exposes its ports and lines by name.

if MIND_IO

config MIND_IO_INIT_PRIORITY
	int "Card read/validation init priority"
	default 55
	help
	  POST_KERNEL priority of the core. It must be after the host I2C bus
	  that carries I2C_CNF, and before MIND_IO_PORT_INIT_PRIORITY.

config MIND_IO_PORT_INIT_PRIORITY
	int "Port slot init priority"
	default 56
	help
	  POST_KERNEL priority of the I2C/SPI port slots. Devices attached
	  under a port slot must initialise after this.

config MIND_IO_CARD_MAX_SIZE
	int "Maximum card image size"
	default 512
	range 12 8192
	help
	  Largest card image read from the card EEPROM, in bytes.

config MIND_IO_SHELL
	bool "mind_io shell commands"
	default y
	depends on SHELL
	help
	  "mio" shell commands: card information, lines, and raw card EEPROM
	  access used by scripts/mio_card.py to program cards.

module = MIND_IO
module-str = mind_io
source "subsys/logging/Kconfig.template.log_config"

rsource "drivers/Kconfig"

endif # MIND_IO
```

## mind_io/drivers/Kconfig
```kconfig
# SPDX-License-Identifier: Apache-2.0

config MIND_IO_I2C_PORT
	bool "mind_io I2C port slots"
	default y
	depends on DT_HAS_MIND_IO_I2C_PORT_ENABLED
	help
	  I2C controller driver for the card's I2C port slots: forwards
	  transfers to the host bus the card assigns to the slot.

config MIND_IO_SPI_PORT
	bool "mind_io SPI port slots"
	default y
	depends on DT_HAS_MIND_IO_SPI_PORT_ENABLED
	depends on SPI
	help
	  SPI controller driver for the card's SPI port slots: drives the
	  chip-select the card assigns to the slot and forwards transfers to
	  the host SPI bus.
```

## mind_io/dts/bindings/mind,din41612-gpios.yaml
```yaml
# SPDX-License-Identifier: Apache-2.0

description: |
  GPIO nexus of the DIN41612 I/O connector: maps connector IO_GPIO<n> to the
  host GPIO of this processing board at build time. Devicetree overlays can
  then use connector GPIO numbers, e.g. for the interrupt line of a device
  attached to a port slot:

    int-gpios = <&mio_gpios 3 GPIO_ACTIVE_LOW>;

compatible: "mind,din41612-gpios"

include: gpio-nexus.yaml
```

## mind_io/dts/bindings/mind,din41612-io.yaml
```yaml
# SPDX-License-Identifier: Apache-2.0

description: |
  DIN41612 I/O card connector of a mind processing board.

  Maps the fixed connector signals to the host peripherals and pins of this
  processing board. The I/O card plugged into the connector describes itself
  in an EEPROM on I2C_CNF; the mind_io module reads it at boot and decides at
  runtime which of these resources the card uses.

  Port slots are child nodes with the "mind,io-i2c-port" and
  "mind,io-spi-port" compatibles. Applications put their own devices under
  them.

  Example:

    mio_connector: connector {
      compatible = "mind,din41612-io";
      i2c-cnf = <&i2c1>;
      i2c-io = <&i2c2>;
      spi = <&spi2>;
      spi-cs0-gpios = <&gpioa 11 GPIO_ACTIVE_HIGH>;
      fault-led-gpios = <&gpiod 5 GPIO_ACTIVE_HIGH>;
      io-gpios = <&gpiod 11 0>, <&gpioe 0 0>, <&gpiob 2 0>, <&gpiob 3 0>;

      mio_i2c_port0: i2c-port-0 {
        compatible = "mind,io-i2c-port";
        slot = <0>;
        #address-cells = <1>;
        #size-cells = <0>;
      };
    };

compatible: "mind,din41612-io"

properties:
  i2c-cnf:
    type: phandle
    required: true
    description: Host I2C bus wired to IO_CNF_SCL / IO_CNF_SDA (card EEPROM bus).

  i2c-io:
    type: phandle
    description: Host I2C bus wired to IO_I2C_SCL / IO_I2C_SDA.

  spi:
    type: phandle
    description: |
      Host SPI bus wired to IO_SPI_SCK / MISO / MOSI. The port slots drive the
      chip-selects themselves, so the bus must not claim IO_SPI_CS0 as its
      hardware NSS pin.

  uart:
    type: phandle
    description: Host UART wired to IO_UART_TX / IO_UART_RX.

  rs485:
    type: phandle
    description: Host UART driving the RS-485 transceiver of IO_RS485_IN_A / B.

  i2s:
    type: phandle
    description: Host I2S controller wired to IO_I2S_*.

  spi-cs0-gpios:
    type: phandle-array
    description: |
      Host GPIO of IO_SPI_CS0. Use GPIO_ACTIVE_HIGH: the active level comes
      from the card description.

  fault-led-gpios:
    type: phandle-array
    description: Host GPIO of IO_F/A, the card's red fault LED (on = high).

  io-gpios:
    type: phandle-array
    description: |
      Host GPIOs of IO_GPIO0..IO_GPIO3, in that order. Use flags 0: direction,
      active level and pulls come from the card description.
```

## mind_io/dts/bindings/mind,io-i2c-port.yaml
```yaml
# SPDX-License-Identifier: Apache-2.0

description: |
  I2C port slot of a mind I/O card. Child of a "mind,din41612-io" node.
  At boot the slot is bound to the host I2C bus the card assigns to it; if
  the card has no I2C port in this slot, the slot and every device under it
  are not ready.

compatible: "mind,io-i2c-port"

include: i2c-controller.yaml

properties:
  slot:
    type: int
    required: true
    description: Slot number referenced by the card's I2C_PORT records (0..3).
```

## mind_io/dts/bindings/mind,io-spi-port.yaml
```yaml
# SPDX-License-Identifier: Apache-2.0

description: |
  SPI port slot of a mind I/O card. Child of a "mind,din41612-io" node.
  Transfers go to the connector SPI bus with the chip-select the card assigns
  to this slot (IO_SPI_CS0, a connector GPIO or an on-card expander pin),
  driven by the slot. If the card has no SPI port in this slot, the slot and
  every device under it are not ready. Devices under the slot use reg = <0>.

compatible: "mind,io-spi-port"

include: spi-controller.yaml

properties:
  slot:
    type: int
    required: true
    description: Slot number referenced by the card's SPI_PORT records (0..3).
```

## mind_io/dts/bindings/test/mind,test-card-eeprom.yaml
```yaml
# SPDX-License-Identifier: Apache-2.0

description: Test-only emulator of a 16-bit addressed card EEPROM (8 KiB).

compatible: "mind,test-card-eeprom"

include: i2c-device.yaml
```

## mind_io/dts/bindings/test/mind,test-pca9557.yaml
```yaml
# SPDX-License-Identifier: Apache-2.0

description: Test-only emulator of the PCA9557 register set.

compatible: "mind,test-pca9557"

include: i2c-device.yaml
```

## mind_io/dts/bindings/test/mind,test-spi-echo.yaml
```yaml
# SPDX-License-Identifier: Apache-2.0

description: |
  Test-only SPI emulator that echoes the transmitted bytes and records the
  chip-select state and bus frequency seen during each transfer.

compatible: "mind,test-spi-echo"

include: spi-device.yaml
```

## nrf24l1_api/mind/jmodem/Kconfig.jmodem
```kconfig
# Copyright (c) 2024 Javad Rahimipetroudi <javad.rahimipetroudi@mind.be>
# SPDX-License-Identifier: Apache-2.0

config BOARD_JMODEM
	select SOC_STM32F103X8
```

## nrf24l1_api/mind/jmodem/board.yml
```yaml
board:
  name: jmodem
  full_name: JModem V1.0
  vendor: mind
  socs:
    - name: stm32f103xb
```
