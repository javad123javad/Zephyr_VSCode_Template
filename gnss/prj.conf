## CMakeLists.txt
```
# Copyright (c) 2023 Trackunit Corporation
# SPDX-License-Identifier: Apache-2.0

cmake_minimum_required(VERSION 3.20.0)
find_package(Zephyr REQUIRED HINTS $ENV{ZEPHYR_BASE})
project(gnss_sample)

target_sources(app PRIVATE src/main.c 
src/modem_radio.c src/modem_radio.h
src/modem_gnss.c  src/modem_gnss.h
src/modem_pipe.c  src/modem_pipe.h

)
```

## prj.conf
```kconfig
# Copyright (c) 2023 Trackunit Corporation
# SPDX-License-Identifier: Apache-2.0

CONFIG_GNSS=y
CONFIG_GNSS_SATELLITES=y

CONFIG_LOG=y
CONFIG_LOG_BUFFER_SIZE=8192
CONFIG_GNSS_DUMP_TO_LOG=y
CONFIG_GNSS_DUMP_TO_LOG_BUF_SIZE=1024
CONFIG_GNSS_LOG_LEVEL_DBG=y
CONFIG_MODEM_MODULES_LOG_LEVEL_DBG=y
CONFIG_REGULATOR=y
```

## boards/zrobot_obc.conf
```kconfig
# Copyright 2024 NXP
# SPDX-License-Identifier: Apache-2.0

CONFIG_UART_INTERRUPT_DRIVEN=y
# CONFIG_GNSS_U_BLOX_6M=y

CONFIG_RF=y
CONFIG_NORDIC_NRF24L01=y
CONFIG_SPI=y
CONFIG_GPIO=y
CONFIG_LOG=y # Debug is disabled to save space   
# CONFIG_LOG_DEFAULT_LEVEL=3
CONFIG_PRINTK=y
CONFIG_NRF24L01_TRIGGER=y
CONFIG_POLL=y
CONFIG_MAIN_STACK_SIZE=3400
```

## boards/zrobot_obc.overlay
```dts
/*
* Copyright 2024 NXP
*
* SPDX-License-Identifier: Apache-2.0
*/

/ {
	aliases {
		gnss = &gnss;
	};
};
// &usart2 {
// 	pinctrl-0 = <&usart2_tx_pd5 &usart2_rx_pd6>;
// 	pinctrl-names = "default";
// 	status = "okay";
// 	current-speed = <9600>;
// 	gnss: u_blox_6m {
// 		status = "okay";
// 		compatible = "gnss-nmea-generic";
// 		//initial-baudrate = <9600>;
// 	};
// };
```

## src/main.c
```c
/*
 * Copyright (c) 2023 Trackunit Corporation
 *
 * SPDX-License-Identifier: Apache-2.0
 */

#include <stdio.h>
#include <zephyr/device.h>
#include <zephyr/drivers/gnss.h>
#include <zephyr/logging/log.h>
#include "common.h"
#include "modem_gnss.h"
#include "modem_pipe.h"
LOG_MODULE_REGISTER(ZBoard);
/* GPS Serial port */
const struct device *const gps_uart_dev = DEVICE_DT_GET(DT_NODELABEL(gps_usart));
////////////
#define DEFAULT_RADIO_NODE DT_NODELABEL(nrf24l1)
BUILD_ASSERT(DT_NODE_HAS_STATUS_OKAY(DEFAULT_RADIO_NODE),
             "No default RF radio specified in DT");
const struct device *const nrf_dev = DEVICE_DT_GET(DEFAULT_RADIO_NODE);
/* Regulators */
#define GPS_REGULATOR   DT_NODELABEL(reg_gps_3p3v)
#define RF_REGULATOR    DT_NODELABEL(reg_radio_3p3v)

const struct device *gps_reg = DEVICE_DT_GET(GPS_REGULATOR);
const struct device *rf_reg = DEVICE_DT_GET(RF_REGULATOR);

int main(void)
{
    int ret = 0;
    /* Enable regulators */
    ret = regulator_enable(gps_reg);
    ret |= regulator_enable(rf_reg);

    k_msleep(1000);

// Config radio PHY


    ret = gnss_init();
#if 1

    k_poll_signal_init(&signal);
    ring_buf_init(&ringbuf, sizeof(ring_buffer), ring_buffer);

    ret = radio_init(nrf_dev);
    if(ret)
    {
        LOG_ERR("Failed to init Radio PHY: %d", ret);
        // return ret;
    }
#endif
    struct k_poll_event events[1] = {
        [0]=K_POLL_EVENT_INITIALIZER(K_POLL_TYPE_SIGNAL,
                                     K_POLL_MODE_NOTIFY_ONLY,
                                     &signal),
    };

    ret = jmodem_pipe_init(gps_uart_dev);
    if(ret)
    {
        LOG_ERR("Unable to init pip: %d", ret);
    }

    for(;;)
    {
        k_poll(events, 1, K_FOREVER);

        int signaled, result;

        k_poll_signal_check(&signal, &signaled, &result);

        if (signaled && (result == 0)) {
            // gpio_pin_toggle_dt(&led);
            // A-OK!
        } else {
            // weird error
        }
        k_poll_signal_reset(&signal);
        events[0].state = K_POLL_STATE_NOT_READY;

    }

    return 0;
}
```

## src/common.h
```c
#ifndef __COMMON_H_
#define __COMMON_H_

#include <stdint.h>
#include <string.h>
#include <zephyr/modem/backend/uart.h>
#include <zephyr/modem/pipe.h>
#include <zephyr/drivers/rf/rf.h>

#define UART_RX_BUF_SIZE    128
#define UART_TX_BUF_SIZE    128
#define CONSOLE_RX_BUF_SIZE 128
#define RF_SPI_BUF_SIZE     32
#define RING_BUF_SIZE       3072

struct modem_data {
    struct {
        uint8_t uart_rx[UART_RX_BUF_SIZE];
        uint8_t uart_tx[UART_TX_BUF_SIZE];
    } buffers;

    struct modem_backend_uart uart_backend;
    struct modem_pipe *uart_pipe;
};

struct msgq_data_item_t {
    uint8_t buf[CONSOLE_RX_BUF_SIZE];
    size_t len;
};


extern struct modem_data data;
extern struct ring_buf ringbuf;
extern uint8_t ring_buffer[RING_BUF_SIZE];
extern struct k_poll_signal signal;
extern const struct device *const nrf_dev;
#endif //__COMMON_H_
```

## src/modem_gnss.c
```c
/*
 * Copyright (c) 2023 Trackunit Corporation
 *
 * SPDX-License-Identifier: Apache-2.0
 */

#include <stdio.h>
#include <zephyr/device.h>
#include <zephyr/drivers/gnss.h>
#include <zephyr/logging/log.h>
#include "modem_gnss.h"
#include "common.h"
#define GNSS_MODEM DEVICE_DT_GET(DT_ALIAS(gnss))

static void gnss_data_cb(const struct device *dev, const struct gnss_data *data)
{
    uint64_t timepulse_ns;
    k_ticks_t timepulse;

    if (data->info.fix_status != GNSS_FIX_STATUS_NO_FIX) {
        if (gnss_get_latest_timepulse(dev, &timepulse) == 0) {
            timepulse_ns = k_ticks_to_ns_near64(timepulse);
            printf("Got a fix (type: %d) @ %lld ns\n", data->info.fix_status,
                   timepulse_ns);
        } else {
            printf("Got a fix (type: %d)\n", data->info.fix_status);
        }
    }
}
GNSS_DATA_CALLBACK_DEFINE(GNSS_MODEM, gnss_data_cb);

// #if CONFIG_GNSS_SATELLITES
static void gnss_satellites_cb(const struct device *dev, const struct gnss_satellite *satellites,
                               uint16_t size)
{
    unsigned int tracked_count = 0;
    unsigned int corrected_count = 0;

    for (unsigned int i = 0; i != size; ++i) {
        tracked_count += satellites[i].is_tracked;
        corrected_count += satellites[i].is_corrected;
    }
    printf("%u satellite%s reported (of which %u tracked, of which %u has RTK corrections)!\n",
           size, size > 1 ? "s" : "", tracked_count, corrected_count);
    if(nrf_dev != NULL)
    {
        rf_send_async(nrf_dev, "Hello\r\n", 7, &signal);
    }
}
// #endif
GNSS_SATELLITES_CALLBACK_DEFINE(GNSS_MODEM, gnss_satellites_cb);

#define GNSS_SYSTEMS_PRINTF(define, supported, enabled)                                            \
	printf("\t%20s: Supported: %3s Enabled: %3s\n",                                            \
	       STRINGIFY(define), (supported & define) ? "Yes" : "No",                             \
			 (enabled & define) ? "Yes" : "No");

int gnss_init(void)
{
    gnss_systems_t supported, enabled;
    uint32_t fix_interval;
    int rc;
    printk("Init modem...\n");
    rc = gnss_get_supported_systems(GNSS_MODEM, &supported);
    if (rc < 0) {
        printf("Failed to query supported systems (%d)\n", rc);
        //return rc;
    }
    rc = gnss_get_enabled_systems(GNSS_MODEM, &enabled);
    if (rc < 0) {
        printf("Failed to query enabled systems (%d)\n", rc);
        //return rc;
    }
    printf("GNSS Systems:\n");
    GNSS_SYSTEMS_PRINTF(GNSS_SYSTEM_GPS, supported, enabled);
    GNSS_SYSTEMS_PRINTF(GNSS_SYSTEM_GLONASS, supported, enabled);
    GNSS_SYSTEMS_PRINTF(GNSS_SYSTEM_GALILEO, supported, enabled);
    GNSS_SYSTEMS_PRINTF(GNSS_SYSTEM_BEIDOU, supported, enabled);
    GNSS_SYSTEMS_PRINTF(GNSS_SYSTEM_QZSS, supported, enabled);
    GNSS_SYSTEMS_PRINTF(GNSS_SYSTEM_IRNSS, supported, enabled);
    GNSS_SYSTEMS_PRINTF(GNSS_SYSTEM_SBAS, supported, enabled);
    GNSS_SYSTEMS_PRINTF(GNSS_SYSTEM_IMES, supported, enabled);

    rc = gnss_get_fix_rate(GNSS_MODEM, &fix_interval);
    if (rc < 0) {
        printf("Failed to query fix rate (%d)\n", rc);
        //return rc;
    }
    printf("Fix rate = %d ms\n", fix_interval);
    // while (1)
    // {
    //     k_msleep(1000);
    //     printk("Waiting...\n");
    //     /* code */
    // }


    return 0;
}
```

## src/modem_gnss.h
```c
#ifndef __GNSS_MODEM_H__
#define __GNSS_MODEM_H__

int gnss_init();
#endif
```

## src/modem_pipe.c
```c
#include "common.h"
#include "modem_pipe.h"
#include <zephyr/usb/usb_device.h>
#include <zephyr/logging/log.h>
LOG_MODULE_REGISTER(ZBoardModem);


uint8_t ring_buffer[RING_BUF_SIZE];

struct ring_buf ringbuf;
/* Buffers for modem backend */

struct modem_data data;

/********* EVENT HANDLER *********/

/* Callback when modem pipe receives data */
static void modem_pipe_event_handler(struct modem_pipe *pipe, enum modem_pipe_event event,
                                     void *user_data)
{
    uint8_t buf[CONSOLE_RX_BUF_SIZE] = {0};
    int ret;
    int rb_len;

    switch (event) {
    case MODEM_PIPE_EVENT_RECEIVE_READY:
        /* Read from modem pipe and send directly to console */
        do {
            ret = modem_pipe_receive(pipe, buf, sizeof(buf));

            if (ret > 0) {
                rb_len = ring_buf_put(&ringbuf, buf, ret);
                if (rb_len < ret) {
                    LOG_ERR("Drop %u bytes", ret - rb_len);
                }
                // printk("wrote\r\n");



            }
        } while (ret > 0);

        break;

    case MODEM_PIPE_EVENT_TRANSMIT_IDLE:
    {

        /* Can send more data if available */
    }
    break;

    default:
        break;
    }
}


/***
 * Init usb modem pipe
 */
int jmodem_pipe_init(const struct device *const uart_dev)
{
    int ret = 0;

    if(!uart_dev)
        return -EINVAL;

    /* Verify modem device is ready */
    if (!device_is_ready(uart_dev)) {
        LOG_ERR("Modem device not ready");
        return -ENODEV;
    }


    init_modem_pipe(uart_dev);
    return ret;

}

int init_modem_pipe(const struct device *const usb_uart_dev)
{
    int ret;

    const struct modem_backend_uart_config uart_backend_config = {
        .uart = usb_uart_dev,
        .receive_buf = data.buffers.uart_rx,
        .receive_buf_size = sizeof(data.buffers.uart_rx),
        .transmit_buf = data.buffers.uart_tx,
        .transmit_buf_size = sizeof(data.buffers.uart_tx),
    };

    data.uart_pipe = modem_backend_uart_init(&data.uart_backend, &uart_backend_config);
    if (data.uart_pipe == NULL) {
        LOG_ERR("Failed to initialize modem backend");
        return -1;
    }

    modem_pipe_attach(data.uart_pipe, modem_pipe_event_handler, &data);

    ret = modem_pipe_open(data.uart_pipe, K_MSEC(100));
    if (ret < 0) {
        LOG_ERR("Failed to open modem pipe");
        return ret;
    }

    LOG_INF("Modem pipe initialized and opened");
    return 0;
}
```

## src/modem_pipe.h
```c
#ifndef __MODEM_PIPE_H_
#define __MODEM_PIPE_H_
#include <zephyr/device.h>
#include <zephyr/drivers/uart.h>
#include <zephyr/kernel.h>

int jmodem_pipe_init(const struct device *const uart_dev);
int init_modem_pipe(const struct device *const uart_dev);

#endif //__MODEM_PIPE_H_
```

## src/modem_radio.c
```c
#include "modem_radio.h"
#include "common.h"
#include <zephyr/logging/log.h>

LOG_MODULE_DECLARE(ZBoard, CONFIG_KERNEL_LOG_LEVEL);


struct k_poll_signal signal;


void recv_async_cb(const struct device *dev, uint8_t *rfdata, uint16_t size)
{
    LOG_INF("[Remote]: Async Received data: %s", rfdata);
    // modem_pipe_transmit(data.uart_pipe, rfdata, size);

}

void rf_send_cb(void *nrf_dev, void *, void*)
{
    LOG_INF("Thread is alive!");
    char buffer[RF_SPI_BUF_SIZE] = {0};
    const struct device *const pnrf_dev =(const struct device *const )nrf_dev;
    for(;;)
    {
        int rb_len = ring_buf_get(&ringbuf, buffer, sizeof(buffer));

        if(rb_len)
        {
            rf_send_async(pnrf_dev, buffer, rb_len, &signal);
        }
        else {
            radio_listen(pnrf_dev);

        }
        // k_msleep(1000);

    }
}

/* TX Thread */
#define TX_STACK_SIZE   1024
#define TX_THREAD_PRIO  6
K_THREAD_STACK_DEFINE(tx_thread_stack, TX_STACK_SIZE);

struct k_thread tx_thread_data;


int radio_init(const struct device *const pnrf_dev)
{
    int ret = 0;
    if (!device_is_ready(pnrf_dev)) {
        LOG_ERR("%s Device not ready", pnrf_dev->name);
        return -1;
    }
    LOG_INF("%s is ready to use.\n", pnrf_dev->name);
    k_tid_t tx_tid = k_thread_create(&tx_thread_data, tx_thread_stack,
                                     K_THREAD_STACK_SIZEOF(tx_thread_stack),
                                     rf_send_cb,
                                     (void*)pnrf_dev, NULL, NULL,
                                     TX_THREAD_PRIO, 0, K_NO_WAIT);
    UNUSED(tx_tid);
    ret = rf_recv_async(pnrf_dev, &recv_async_cb);
    return ret;
}

inline int radio_listen(const struct device *const pnrf_dev)
{
    return rf_recv_async(pnrf_dev, &recv_async_cb);
}
```
