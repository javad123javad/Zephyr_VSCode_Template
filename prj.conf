## CMakeLists.txt
```
# SPDX-License-Identifier: Apache-2.0

cmake_minimum_required(VERSION 3.20.0)

find_package(Zephyr REQUIRED HINTS $ENV{ZEPHYR_BASE})
project(gps_logger)

target_sources(app PRIVATE src/main.c)
```

## sample.yaml
```
sample:
  description: GPS logger
    application
  name: GPS logger
common:
  min_ram: 2
  min_flash: 16
  tags: introduction
  integration_platforms:
    - native_sim
  harness: console
  harness_config:
    type: one_line
    regex:
      - "Hello World! (.*)"
tests:
  sample.basic.helloworld:
    tags: introduction
```

## prj.conf
```kconfig
# nothing here
CONFIG_GNSS=y
CONFIG_GNSS_SATELLITES=y

CONFIG_LOG=y
CONFIG_LOG_BUFFER_SIZE=8192
CONFIG_GNSS_DUMP_TO_LOG=y
CONFIG_GNSS_DUMP_TO_LOG_BUF_SIZE=1024
CONFIG_GNSS_LOG_LEVEL_DBG=y
CONFIG_MODEM_MODULES_LOG_LEVEL_DBG=y
```

## src/main.c
```c
/*
 * Copyright (c) 2012-2014 Wind River Systems, Inc.
 *
 * SPDX-License-Identifier: Apache-2.0
 */

#include <stdio.h>
#include <zephyr/kernel.h>
int i;
int main(void)
{
	printf("Hello World! %s\n", CONFIG_BOARD_TARGET);
	i = 10;

	printf("Int is: %d\n", i);
	
	return 0;
}
```
