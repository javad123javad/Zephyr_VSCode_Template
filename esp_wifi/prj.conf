## prj.conf
```kconfig
CONFIG_EARLY_CONSOLE=y
CONFIG_NETWORKING=y
CONFIG_TEST_RANDOM_GENERATOR=y

CONFIG_MAIN_STACK_SIZE=5200
CONFIG_SHELL_STACK_SIZE=5200
CONFIG_NET_TX_STACK_SIZE=2048
CONFIG_NET_RX_STACK_SIZE=2048

CONFIG_NET_PKT_RX_COUNT=10
CONFIG_NET_PKT_TX_COUNT=10
CONFIG_NET_BUF_RX_COUNT=20
CONFIG_NET_BUF_TX_COUNT=20
CONFIG_NET_MAX_CONTEXTS=10
CONFIG_NET_DHCPV4=y

CONFIG_NET_IPV4=y
CONFIG_NET_IPV6=n

CONFIG_NET_TCP=y

CONFIG_NET_LOG=y
CONFIG_INIT_STACKS=y

CONFIG_NET_SHELL=y

CONFIG_NET_STATISTICS=y
CONFIG_NET_STATISTICS_PERIODIC_OUTPUT=n

CONFIG_WIFI=y
CONFIG_WIFI_LOG_LEVEL_DBG=y
CONFIG_MODEM_LOG_LEVEL_DBG=y
CONFIG_NET_L2_WIFI_SHELL=y
# printing of scan results puts pressure on queues in new locking
# design in net_mgmt. So, use a higher timeout for a crowded
# environment.
CONFIG_NET_MGMT_EVENT_QUEUE_TIMEOUT=5000
CONFIG_NET_MGMT_EVENT_QUEUE_SIZE=16
CONFIG_NET_MGMT_EVENT_STACK_SIZE=4200
CONFIG_NET_IF_MAX_IPV4_COUNT=2
#########
########### Set offloaded iface as primary interface
CONFIG_NET_DEFAULT_IF_OFFLOAD=y
# DNS
CONFIG_DNS_RESOLVER=y
CONFIG_DNS_SERVER_IP_ADDRESSES=y
CONFIG_DNS_SERVER1="8.8.8.8"
CONFIG_DNS_SERVER2="1.1.1.1"
```

## src/wifi_test.c
```c
/*
 * Copyright (c) 2016 Intel Corporation.
 *
 * SPDX-License-Identifier: Apache-2.0
 */
#include <zephyr/kernel.h>
#include <zephyr/net/socket.h>
#include <zephyr/net/net_if.h>
#include <zephyr/net/net_event.h>
#include <zephyr/net/net_mgmt.h>
#include <zephyr/net/wifi_mgmt.h>
#include <errno.h>

//#define WIFI_SSID     "Proximus-Home-E9C0"
//#define WIFI_PASSWORD "wdju9h4ce23b7"

#define WIFI_SSID     "Mind-Wifi"
#define WIFI_PASSWORD "fRGY7VKD5hSsHxn5"
#define HTTP_HOST    "httpbin.org"
#define HTTP_PORT    80
#define HTTP_REQUEST "GET /get HTTP/1.0\r\nHost: " HTTP_HOST "\r\nConnection: close\r\n\r\n"

static K_SEM_DEFINE(net_ready, 0, 1);
static struct net_mgmt_event_callback if_cb;

static void if_event_handler(struct net_mgmt_event_callback *cb,
                             uint64_t event, struct net_if *iface)
{
	if (event == NET_EVENT_IF_UP) {
		k_sem_give(&net_ready);
	}
}

static int wifi_connect(struct net_if *iface)
{
	struct wifi_connect_req_params params = {
		.ssid        = WIFI_SSID,
		.ssid_length = strlen(WIFI_SSID),
		.psk         = WIFI_PASSWORD,
		.psk_length  = strlen(WIFI_PASSWORD),
		.security    = WIFI_SECURITY_TYPE_PSK,
		.channel     = WIFI_CHANNEL_ANY,
		.band        = WIFI_FREQ_BAND_2_4_GHZ,
	};

	return net_mgmt(NET_REQUEST_WIFI_CONNECT, iface, &params, sizeof(params));
}

static int http_get(void)
{
	int sock = zsock_socket(AF_INET, SOCK_STREAM, IPPROTO_TCP);

	if (sock < 0) {
		printk("socket() failed: %d\n", errno);
		return -1;
	}

	struct ifreq ifr = {0};

	strncpy(ifr.ifr_name, "wlan0", sizeof(ifr.ifr_name));
	zsock_setsockopt(sock, SOL_SOCKET, SO_BINDTODEVICE, &ifr, sizeof(ifr));

	struct zsock_timeval timeout = {.tv_sec = 15};

	zsock_setsockopt(sock, SOL_SOCKET, SO_RCVTIMEO, &timeout, sizeof(timeout));
	zsock_setsockopt(sock, SOL_SOCKET, SO_SNDTIMEO, &timeout, sizeof(timeout));

	struct zsock_addrinfo hints = {
		.ai_family   = AF_INET,
		.ai_socktype = SOCK_STREAM,
	};
	struct zsock_addrinfo *res;
	int dns_ret = zsock_getaddrinfo(HTTP_HOST, NULL, &hints, &res);

	if (dns_ret != 0) {
		printk("DNS lookup for %s failed: %d\n", HTTP_HOST, dns_ret);
		zsock_close(sock);
		return -1;
	}

	struct sockaddr_in addr = *(struct sockaddr_in *)res->ai_addr;

	addr.sin_port = htons(HTTP_PORT);
	zsock_freeaddrinfo(res);

	char addr_str[INET_ADDRSTRLEN];

	zsock_inet_ntop(AF_INET, &addr.sin_addr, addr_str, sizeof(addr_str));
	printk("Connecting to %s:%d (%s)...\n", HTTP_HOST, HTTP_PORT, addr_str);
	if (zsock_connect(sock, (struct sockaddr *)&addr, sizeof(addr)) < 0) {
		printk("Connect failed: errno=%d\n", errno);
		zsock_close(sock);
		return -1;
	}
	printk("Connected!\n");

	int sent = zsock_send(sock, HTTP_REQUEST, strlen(HTTP_REQUEST), 0);

	if (sent < 0) {
		printk("Send failed: errno=%d\n", errno);
		zsock_close(sock);
		return -1;
	}
	printk("Request sent (%d bytes)\n", sent);

	printk("--- Response ---\n");
	char buf[256];
	int total = 0;
	int len;

	while ((len = zsock_recv(sock, buf, sizeof(buf) - 1, 0)) > 0) {
		buf[len] = '\0';
		printk("%s", buf);
		total += len;
	}

	printk("\n--- End (%d bytes) ---\n", total);
	zsock_close(sock);
	return 0;
}

int main(void)
{
	struct net_if *iface = net_if_get_first_wifi();

	printk("Interface name: %s\n", net_if_get_device(iface)->name);

	net_mgmt_init_event_callback(&if_cb, if_event_handler, NET_EVENT_IF_UP);
	net_mgmt_add_event_callback(&if_cb);

	if (net_if_is_up(iface)) {
		k_sem_give(&net_ready);
	} else {
		wifi_connect(iface);
	}

	printk("Waiting for network...\n");
	k_sem_take(&net_ready, K_FOREVER);
	k_sleep(K_SECONDS(2));

	return http_get();
}
```
